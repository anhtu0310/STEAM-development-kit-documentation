## src/live_lab_console/main/Kconfig.projbuild
```kconfig
menu "STEAM Live Lab Console"

    config LLC_BOUNCE_LINES
        int "VGA bounce-buffer height (lines)"
        default 20
        range 10 40
        help
            Height of each of the two internal-SRAM bounce buffers. 600 must be
            divisible by it (10, 12, 15, 20, 24, 25, 30 or 40). Each buffer uses
            1600 bytes per line, so 20 lines = 2 x 32 KB. A taller buffer gives
            the refill interrupt more slack (T_bb = lines x 28.4 us).

    config LLC_WIFI_AP_SSID
        string "Wi-Fi soft-AP SSID"
        default "STEAM-LAB"

    config LLC_WIFI_AP_PASSWORD
        string "Wi-Fi soft-AP password (8+ characters, empty = open)"
        default "steamlab"

    config LLC_WIFI_AP_CHANNEL
        int "Wi-Fi soft-AP channel"
        default 6
        range 1 13

    config LLC_ETH_FALLBACK_IP
        string "Ethernet static address used when no DHCP lease arrives"
        default "192.168.50.2"
        help
            Lets a laptop wired straight to the board (192.168.50.1/24) reach
            the dashboard without a router, as in the E1 bench setup.

    config LLC_RELAY_MAX_ON_SECONDS
        int "Relay automatic-off time (seconds)"
        default 30
        range 1 3600

    config LLC_BLE_REMOTE_NAME
        string "BLE remote advertised name"
        default "AB Shutter3"

endmenu
```

## src/same_pins_two_worlds/main/Kconfig.projbuild
```kconfig
menu "STEAM Same Pins, Two Worlds"

    config SPTW_BOUNCE_LINES
        int "VGA bounce-buffer height (lines)"
        default 20
        range 10 40
        help
            Height of each of the two internal-SRAM bounce buffers. 600 must be
            divisible by it (10, 12, 15, 20, 24, 25, 30 or 40). Same meaning as
            in the Live Lab Console.

    config SPTW_SEG_ACTIVE_LOW
        bool "7-segment segments light on a LOW 74HC595 output (common anode)"
        default y
        help
            The kit's 7seg.ino example drives common-anode digits with LOW =
            segment on. STEAM_PERIPHERAL_SHOWCASE_IDF54 sends the opposite
            polarity. If every digit shows its complement, change this.

    config SPTW_SEG_REVERSE_DIGITS
        bool "Shift the leftmost digit first"
        default n
        help
            By default the rightmost digit is shifted first, so it ends in the
            last 74HC595 of the chain. Turn this on if "GP17" reads "71PG".

    config SPTW_MATRIX_INTENSITY
        int "MAX7219 intensity (0-15)"
        default 4
        range 0 15

    config SPTW_WS2812_COUNT
        int "Number of WS2812B LEDs in the chain"
        default 2
        range 1 16

endmenu
```
